## esp32-c3/sdkconfig.defaults
```kconfig
CONFIG_ESP_CONSOLE_USB_SERIAL_JTAG=y
CONFIG_ESP_CONSOLE_UART_DEFAULT=n
CONFIG_ESP_CONSOLE_NONE=y
CONFIG_ESPTOOLPY_FLASHSIZE_4MB=y
CONFIG_ESPTOOLPY_FLASHSIZE="4MB"
CONFIG_ESPTOOLPY_FLASHSIZE_2MB=n
CONFIG_ESP_SYSTEM_PANIC_PRINT_REBOOT=y
```

## esp32-s3/sdkconfig.defaults
```kconfig
CONFIG_ESP_CONSOLE_USB_SERIAL_JTAG=y
CONFIG_ESP_CONSOLE_UART_DEFAULT=n
CONFIG_ESP_CONSOLE_NONE=y
CONFIG_ESP_SYSTEM_PANIC_PRINT_REBOOT=y
```
